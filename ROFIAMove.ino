//    Poser action playback
//      This program was generated by Project Biped Poser to playback a specific action.
//    Use it as the starting point for your projects!
//
//    Copyright (C) 2012  Jonathan Dowdall, Project Biped (www.projectbiped.com)
//
//    This program is free software: you can redistribute it and/or modify
//    it under the terms of the GNU General Public License as published by
//    the Free Software Foundation, either version 3 of the License, or
//    (at your option) any later version.
//
//    This program is distributed in the hope that it will be useful,
//    but WITHOUT ANY WARRANTY; without even the implied warranty of
//    MERCHANTABILITY or FITNESS FOR A PARTICULAR PURPOSE.  See the
//    GNU General Public License for more details.
//
//    You should have received a copy of the GNU General Public License
//    along with this program.  If not, see <http://www.gnu.org/licenses/>.

#include <Servo.h> 

//////////////////////////////////////////////////////////////////////////////////////////////////////////////////////////////////////////////
// Constants
//////////////////////////////////////////////////////////////////////////////////////////////////////////////////////////////////////////////
const int numberOfServos             = 12;    // the number of servos
const int numberOfJoints             = 12;
const int numberOfHeadServos         = 2;
const int numberOfFramesForward      = 121;   // Frames for moving forward
const int playbackDelayForward       = 10;    // Delay between the forward walk frames to achieve a stable speed
const int numberOfFramesNeutral      = 5;     // Frames for moving to home position
const int playbackDelayNeutral       = 20;    // Delay between the nuetral frames to achieve a stable speed
const int numberOfFramesRight        = 30;    // Delay between the right turn frames to achieve a stable speed
const int playbackDelayRight         = 25;    // Delay between the right turn frames to achieve a stable speed
const int ultrasonicConstant         = 58;    // Calculation for the distance detected by the ultrasonic sensor
                                              // Speed of sound is about 340 m/s -> 29 microseconds/cm, divide
                                              // the time taken for the ultrasonic sensor to detect by 2 to get
                                              // the time taken by the pulse to reach the object, then divide by
                                              // the ultrasonic constant to get the distance in centimeters.
const int pingPin                    = 4;     // Ultrasonic sensor pin

//////////////////////////////////////////////////////////////////////////////////////////////////////////////////////////////////////////////
// Action Frames
//////////////////////////////////////////////////////////////////////////////////////////////////////////////////////////////////////////////
//Joints positions are in degrees * 100 (home position is 0 degrees)
/////////////////////////////////////////////
//JOINT INDEXES
//
//RIGHT LEG JOINTS
// 0 Right Ankle (roll)
// 1 Right Lower Leg 
// 2 Right Knee 
// 3 Right Middle Leg 
// 4 Right Upper Leg 
// 5 Right Hip (roll)
//LEFT LEG JOINTS
// 6 Left Ankle (roll)
// 7 Left Lower Leg 
// 8 Left Knee 
// 9 Left Middle Leg 
// 10 Left Upper Leg 
// 11 Left Hip (roll)
/////////////////////////////////////////////
int servoPins[numberOfServos] = {22, 24, 26, 28, 30, 32, 38, 40, 42, 44, 46, 48};  // the pin for each servo 

int framesForward[numberOfFramesForward][numberOfJoints] = {
                      { -134, -2393,     0,     0, -3100,  1400, -1100,  1200,   800,     0,     0, -2300 },
                      {  408, -2152,     0,     0, -2856,  1536, -1343,  1096,   800,     0,    91, -2300 },
                      {  952, -1911,     0,     0, -2613,  1673, -1586,   992,   800,     0,   182, -2300 },
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                      { -245, -2238,   145,     0, -2975,  1056,  -985,  1085,   446,    83,   395, -2040 }
};

int framesNeutral[numberOfFramesNeutral][numberOfJoints] = {
                      { -245, -2238,   145,     0, -2975,  1056,  -985,  1085,   446,    83,   395,  -2040 },
                      { -184, -1679,   109,     0, -2231,   792,  -739,   814,   335,    62,   296,  -1530 },
                      { -123, -1119,    73,     0, -1488,   528,  -493,   543,   223,    42,   198,  -1020 },
                      {  -61,  -560,    36,     0,  -744,   264,  -246,   271,   112,    21,    99,   -510 },
                      {    0,     0,     0,     0,     0,     0,     0,     0,     0,     0,     0,      0 }
};

int framesRight[numberOfFramesRight][numberOfJoints] = {
                      {    0,     0,     0,     0,     0,     0,     0,     0,     0,     0,     0,     0 },
                      { -323,  -148,  -320,  -180,   400,  -340,   340,     0,     0,     0,   200,   240 },
                      { -646,  -296,  -640,  -360,   800,  -680,   680,     0,     0,     0,   400,   480 },
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                      { -417,  -296,  -359,     0,    79,  -519,   219,   739,   219,   -79,   539,   339 }
};

int servoCalibrations[numberOfJoints][3] = {
                      {2279, 2063, 1500}, 
                      {858, 238, 439}, 
                      {-500, -1100, -1400}, 
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                      {1200, 700, 200}
};

//////////////////////////////////////////////////////////////////////////////////////////////////////////////////////////////////////////////
// Variables
//////////////////////////////////////////////////////////////////////////////////////////////////////////////////////////////////////////////
Servo servos[numberOfServos];  // create servo object to control a servo 
//Servo scanServo;               // Head servo for scanning
//Servo tiltServo;               // Head servo for tilting

//////////////////////////////////////////////////////////////////////////////////////////////////////////////////////////////////////////////
void setup()
//////////////////////////////////////////////////////////////////////////////////////////////////////////////////////////////////////////////
{
  //wait for a second to begin (keeps the communication line open in case a new program is being downloaded)
  delay(1000);    
  
  //start up the communication
  Serial.begin(9600);  
  
  //initialize the servos
  initializeServos();
  
  // Apply the servo calibrations to the joint positions.
  ApplyCalibration();
  
  // Default position for tilt servo
//  tiltServo.write(150);
//  scanServo.write(96);
  
  PlayFrames(numberOfFramesNeutral, playbackDelayNeutral);
  delay(1000);
  
  // Delay to give the user time to set the robot down after the legs straighten out
  delay(2000);
  
}

//////////////////////////////////////////////////////////////////////////////////////////////////////////////////////////////////////////////
void loop()
//////////////////////////////////////////////////////////////////////////////////////////////////////////////////////////////////////////////
{
  
  // Distance detected by the ultrasonic sensor
  unsigned long cm = DetectDistance(pingPin);
  delay(50);

  // The robot will walk forward, but will turn right if there is an obstacle 30 cm or less in front of it
  if(cm >= 43)                  
    PlayFrames(numberOfFramesForward, playbackDelayForward);
  else
  {
    PlayFrames(numberOfFramesNeutral, playbackDelayNeutral);
    for (int i = 0; i < 4; i++) 
      PlayFrames(numberOfFramesRight, playbackDelayRight);                  
  }
}

//////////////////////////////////////////////////////////////////////////////////////////////////////////////////////////////////////////////
long DetectDistance(int pingPin)
//////////////////////////////////////////////////////////////////////////////////////////////////////////////////////////////////////////////
{
  // The PING))) is triggered by a HIGH pulse of 2 or more microseconds.
  // Give a short LOW pulse beforehand to ensure a clean HIGH pulse:
  pinMode(pingPin, OUTPUT);
  digitalWrite(pingPin, LOW);
  delayMicroseconds(2);
  digitalWrite(pingPin, HIGH);
  delayMicroseconds(5);
  digitalWrite(pingPin, LOW);

  // The same pin is used to read the signal from the PING))): a HIGH
  // pulse whose duration is the time (in microseconds) from the sending
  // of the ping to the reception of its echo off of an object.
  pinMode(pingPin, INPUT);
  long duration = pulseIn(pingPin, HIGH);

  // convert the time into a distance
  long cm = duration / ultrasonicConstant;
  return cm;
}

//////////////////////////////////////////////////////////////////////////////////////////////////////////////////////////////////////////////
void PlayFrames(int numberOfFrames, int playbackDelay)
//////////////////////////////////////////////////////////////////////////////////////////////////////////////////////////////////////////////
{
  // Angle value of the servo
  int value;
  // This for loop determines the animation frame the robot is playing through
  for (int framesRowNumber = 0; framesRowNumber < numberOfFrames; framesRowNumber++)
  {
    // This for loop adjusts the position of each servo
    for (int servo = 0; servo < numberOfServos; servo++)
    {   
//        scanServo.write(78); // Keeps head scan in one position while walking
      
        // each servo position is sent as a 2 byte value (high byte, low byte) integer (from -32,768 to 32,767)
        // this number is encoding the angle of the servo. The number is 100 * the servo angle.  This allows for the
        // storage of 2 significant digits(i.e. the value can be from -60.00 to 60.00 and every value in between).
        // Also remember that the servos have a range of 120 degrees. The angle is written in positions
        // which range from a minimum of 800 (-60 degrees) and go to a maximum of 2200 (60 degrees)
        
        // This branch determines whether or not the robot is walking forward or turning left based on
        // the parameters passed in the main loop    
        if (numberOfFrames == numberOfFramesForward)      value = framesForward[framesRowNumber][servo];
        else if (numberOfFrames == numberOfFramesNeutral) value = framesNeutral[framesRowNumber][servo];
        else if (numberOfFrames == numberOfFramesRight)   value = framesRight[framesRowNumber][servo];
        
        // flip for the left leg.
        if(servo >= numberOfServos/2) value = map(value, -6000,6000,6000,-6000);
        
        // tell servo to go to position in variable 'pos'
        servos[servo].write(map(value, -6000,6000,800,2200));   
        // This delay controls the delay between each servo being updated       
        delay(2);
    }
  // This delay controls the delay between each frame
  // This will vary based on the animation and may need to be changed if you make your own
  // animation with a different speed.
  delay(playbackDelay);
  }
}

//////////////////////////////////////////////////////////////////////////////////////////////////////////////////////////////////////////////
void ApplyCalibration()
//////////////////////////////////////////////////////////////////////////////////////////////////////////////////////////////////////////////
{   
  // Apply the servo calibrations to each frame of the animation.
  // This is done before hand to keep from slowing down the playback.
  // The frames could also be stored with the calibrations already
  // applied, however leaving the calibration seperate allows other
  // ROFIs to use this same action with their own calibration.
  
  for(int f = 0; f < numberOfFramesForward; f++)
    for(int s = 0; s < numberOfServos; s++)    
      framesForward[f][s] = CorrectJointAngle(framesForward[f][s], s);
      
  for(int f = 0; f < numberOfFramesNeutral; f++)
    for(int s = 0; s < numberOfServos; s++)    
      framesNeutral[f][s] = CorrectJointAngle(framesNeutral[f][s], s);
      
  for(int f = 0; f < numberOfFramesRight; f++)
    for(int s = 0; s < numberOfServos; s++)    
      framesRight[f][s] = CorrectJointAngle(framesRight[f][s], s);
}

/////////////////////////////////////////////////////////////////////////////////////////////////////////////////////
double CorrectJointAngle(double inputAngle, int servo)
/////////////////////////////////////////////////////////////////////////////////////////////////////////////////////
{
  // The input angle is what the angle should be.
  // The corrected angle is the angle that has to be sent to the servo to achieve the input angle.
  if (inputAngle > 0)
    // Do a two point calibration between the middle and high corrected values.
    return map(inputAngle, 0, 4500, 0 + servoCalibrations[servo][1], 4500 + servoCalibrations[servo][2]);
  else
    // Do a two point calibration between the low and middle corrected values.
    return map(inputAngle, -4500, 0, -4500 + servoCalibrations[servo][0], 0 + servoCalibrations[servo][1]);
}

//////////////////////////////////////////////////////////////////////////////////////////////////////////////////////////////////////////////
void initializeServos()
//////////////////////////////////////////////////////////////////////////////////////////////////////////////////////////////////////////////
{   
  // Assign the correct pin to each servo.
  for(int s = 0; s < numberOfServos; s++)
    servos[s].attach(servoPins[s]);
  
//  scanServo.attach(34);
//  tiltServo.attach(36);
}
