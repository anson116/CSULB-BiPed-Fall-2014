#include <Servo.h> 
#include <SPI.h>
#include <Adb.h>

//////////////////////////////////////////////////////////////////////////////////////////////////////////////////////////////////////////////
// Define
//////////////////////////////////////////////////////////////////////////////////////////////////////////////////////////////////////////////
#define FALSE 0
#define TRUE  1
// Commands to Numeric Value Mapping
//               Data[0] =   CMD TYPE | Qual
//                        bit  7654321   0      
#define MOVE         0x01   // 0000000   1        
#define CAMERA_MOVE  0x02   // 0000001   0                  
#define CAMERA_HOME  0x04   // 0000010   0
#define LED_1        0x40   // 0000000   1 
#define LED_2        0x41   // 0000000   1 
#define LED_3        0x42   // 0000000   1 
#define LEDcount  3


//////////////////////////////////////////////////////////////////////////////////////////////////////////////////////////////////////////////
// Constants
//////////////////////////////////////////////////////////////////////////////////////////////////////////////////////////////////////////////
const int numberOfServos             = 12;    // the number of servos
const int numberOfJoints             = 12;
const int numberOfFramesForward      = 126;
const int playbackDelayForward       = 10;    // Delay between the forward walk frames to achieve a stable speed
const int numberOfFramesRight        = 35;    // Delay between the right turn frames to achieve a stable speed
const int playbackDelayRight         = 25;
const int ultrasonicConstant         = 58;    // Calculation for the distance detected by the ultrasonic sensor
                                              // Speed of sound is about 340 m/s -> 29 microseconds/cm, divide
                                              // the time taken for the ultrasonic sensor to detect by 2 to get
                                              // the time taken by the pulse to reach the object, then divide by
                                              // the ultrasonic constant to get the distance in centimeters.
const int pingPin                    = 4;     // Ultrasonic sensor pin

//////////////////////////////////////////////////////////////////////////////////////////////////////////////////////////////////////////////
// Action Frames
//////////////////////////////////////////////////////////////////////////////////////////////////////////////////////////////////////////////
//Joints positions are in degrees * 100 (home position is 0 degrees)
/////////////////////////////////////////////
//JOINT INDEXES
//
//RIGHT LEG JOINTS
// 0 Right Ankle (roll)
// 1 Right Lower Leg 
// 2 Right Knee 
// 3 Right Middle Leg 
// 4 Right Upper Leg 
// 5 Right Hip (roll)
//LEFT LEG JOINTS
// 6 Left Ankle (roll)
// 7 Left Lower Leg 
// 8 Left Knee 
// 9 Left Middle Leg 
// 10 Left Upper Leg 
// 11 Left Hip (roll)
/////////////////////////////////////////////
int servoPins[numberOfServos] = {22, 24, 26, 28, 30, 32, 38, 40, 42, 44, 46, 48};  // the pin for each servo 

int framesForward[numberOfFramesForward][numberOfJoints] = {
                      {    0,     0,     0,     0,     0,     0,     0,     0,     0,     0,     0,     0 },
                      {  -29,  -521,     0,     0,  -675,   304,  -239,   261,   174,     0,     0,  -500 },
                      {  -58, -1042,     0,     0, -1350,   609,  -479,   522,   348,     0,     0, -1001 },
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                      {  -67,   -50,    78,     0,  -106,  -106,     0,     5,  -145,    44,   212,    11 }
};

int framesRight[numberOfFramesRight][numberOfJoints] = {
                      {    0,     0,     0,     0,     0,     0,     0,     0,     0,     0,     0,     0 },
                      { -323,  -148,  -320,  -180,   400,  -340,   340,     0,     0,     0,   200,   240 },
                      { -646,  -296,  -640,  -360,   800,  -680,   680,     0,     0,     0,   400,   480 },
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                      {    0,     0,     0,     0,     0,     0,     0,     0,     0,     0,     0,     0 }
};

int servoCalibrations[numberOfJoints][3] = {
                      {691, 29, -404}, 
                      {-407, -507, -973}, 
                      {100, -700, -1200}, 
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                      {100, -300, -541}
};

//////////////////////////////////////////////////////////////////////////////////////////////////////////////////////////////////////////////
// Variables
//////////////////////////////////////////////////////////////////////////////////////////////////////////////////////////////////////////////
Servo servos[numberOfServos];  // create servo object to control a servo 

//////////////////////////////////////////////////////////////////////////////////////////////////////////////////////////////////////////////
void loop()
//////////////////////////////////////////////////////////////////////////////////////////////////////////////////////////////////////////////
{
// Distance detected by the ultrasonic sensor
unsigned long cm = DetectDistance(pingPin);
delay(50);
// The robot will walk forward, but will turn right if there is an obstacle 30 cm or less in front of it
if(cm >= 30)
PlayFrames(numberOfFramesForward, playbackDelayForward);
else
{
for (int i = 0; i < 4; i++)
          PlayFrames(numberOfFramesRight, playbackDelayRight);                  
  
}
}

//////////////////////////////////////////////////////////////////////////////////////////////////////////////////////////////////////////////
void setup()
//////////////////////////////////////////////////////////////////////////////////////////////////////////////////////////////////////////////
{
  //wait for a second to begin (keeps the communication line open in case a new program is being downloaded)
  delay(1000);    
  
  //start up the communication
  Serial.begin(9600);  
  
  //initialize the servos
  initializeServos();
  
  // Apply the servo calibrations to the joint positions.
  ApplyCalibration();

  delay(3000);
  
}


//////////////////////////////////////////////////////////////////////////////////////////////////////////////////////////////////////////////
long DetectDistance(int pingPin)
//////////////////////////////////////////////////////////////////////////////////////////////////////////////////////////////////////////////
{
  // The PING))) is triggered by a HIGH pulse of 2 or more microseconds.
  // Give a short LOW pulse beforehand to ensure a clean HIGH pulse:
  pinMode(pingPin, OUTPUT);
  digitalWrite(pingPin, LOW);
  delayMicroseconds(2);
  digitalWrite(pingPin, HIGH);
  delayMicroseconds(5);
  digitalWrite(pingPin, LOW);

  // The same pin is used to read the signal from the PING))): a HIGH
  // pulse whose duration is the time (in microseconds) from the sending
  // of the ping to the reception of its echo off of an object.
  pinMode(pingPin, INPUT);
  long duration = pulseIn(pingPin, HIGH);

  // convert the time into a distance
  long cm = duration / ultrasonicConstant;
  return cm;
}

//////////////////////////////////////////////////////////////////////////////////////////////////////////////////////////////////////////////
void PlayFrames(int numberOfFrames, int playbackDelay)
//////////////////////////////////////////////////////////////////////////////////////////////////////////////////////////////////////////////
{
  // Angle value of the servo
  int value;
  // This for loop determines the animation frame the robot is playing through
  for (int framesRowNumber = 0; framesRowNumber < numberOfFrames; framesRowNumber++)
  {
    // This for loop adjusts the position of each servo
    for (int servo = 0; servo < numberOfServos; servo++)
    {   
        // each servo position is sent as a 2 byte value (high byte, low byte) integer (from -32,768 to 32,767)
        // this number is encoding the angle of the servo. The number is 100 * the servo angle.  This allows for the
        // storage of 2 significant digits(i.e. the value can be from -60.00 to 60.00 and every value in between).
        // Also remember that the servos have a range of 120 degrees. The angle is written in positions
        // which range from a minimum of 800 (-60 degrees) and go to a maximum of 2200 (60 degrees)
        
        // This branch determines whether or not the robot is walking forward or turning left based on
        // the parameters passed in the main loop    
        if (numberOfFrames == numberOfFramesForward)    value = framesForward[framesRowNumber][servo];
        else if (numberOfFrames == numberOfFramesRight) value = framesRight[framesRowNumber][servo];
        
        // flip for the left leg.
        if(servo >= numberOfServos/2) value = map(value, -6000,6000,6000,-6000);
        
        // tell servo to go to position in variable 'pos'
        servos[servo].write(map(value, -6000,6000,800,2200));   
        // This delay controls the delay between each servo being updated       
        delay(2);
    }
  // This delay controls the delay between each frame
  // This will vary based on the animation and may need to be changed if you make your own
  // animation with a different speed.
  delay(playbackDelay);
  }
}

//////////////////////////////////////////////////////////////////////////////////////////////////////////////////////////////////////////////
void ApplyCalibration()
//////////////////////////////////////////////////////////////////////////////////////////////////////////////////////////////////////////////
{   
  // Apply the servo calibrations to each frame of the animation.
  // This is done before hand to keep from slowing down the playback.
  // The frames could also be stored with the calibrations already
  // applied, however leaving the calibration seperate allows other
  // ROFIs to use this same action with their own calibration.
  
  for(int f = 0; f < numberOfFramesForward; f++)
    for(int s = 0; s < numberOfServos; s++)    
      framesForward[f][s] = CorrectJointAngle(framesForward[f][s], s);
      
  for(int f = 0; f < numberOfFramesRight; f++)
    for(int s = 0; s < numberOfServos; s++)    
      framesRight[f][s] = CorrectJointAngle(framesRight[f][s], s);
}

/////////////////////////////////////////////////////////////////////////////////////////////////////////////////////
double CorrectJointAngle(double inputAngle, int servo)
/////////////////////////////////////////////////////////////////////////////////////////////////////////////////////
{
  // The input angle is what the angle should be.
  // The corrected angle is the angle that has to be sent to the servo to achieve the input angle.
  if (inputAngle > 0)
    // Do a two point calibration between the middle and high corrected values.
    return map(inputAngle, 0, 4500, 0 + servoCalibrations[servo][1], 4500 + servoCalibrations[servo][2]);
  else
    // Do a two point calibration between the low and middle corrected values.
    return map(inputAngle, -4500, 0, -4500 + servoCalibrations[servo][0], 0 + servoCalibrations[servo][1]);
}

//////////////////////////////////////////////////////////////////////////////////////////////////////////////////////////////////////////////
void initializeServos()
//////////////////////////////////////////////////////////////////////////////////////////////////////////////////////////////////////////////
{   
  // Assign the correct pin to each servo.
  for(int s = 0; s < numberOfServos; s++)
    servos[s].attach(servoPins[s]);  
}
